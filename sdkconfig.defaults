## sdkconfig.defaults
```kconfig
# Board Configuration: LyraT V4.3 (Compatible driver)
CONFIG_ESP_LYRAT_V4_3_BOARD=y
# CONFIG_AUDIO_BOARD_AI_THINKER_AUDIO_KIT=y

# PSRAM Configuration (Crucial for Audio buffering)
CONFIG_SPIRAM=y
CONFIG_SPIRAM_BOOT_INIT=y
CONFIG_SPIRAM_USE_MALLOC=y
CONFIG_SPIRAM_ALLOW_STACK_EXTERNAL_MEMORY=y

# Frequency Limiting (for stability)
CONFIG_ESP_DEFAULT_CPU_FREQ_MHZ_160=y
CONFIG_ESP_DEFAULT_CPU_FREQ_MHZ=160

# Reduce Serial Output in Boot
CONFIG_BOOTLOADER_LOG_LEVEL_WARN=y
CONFIG_FREERTOS_ENABLE_BACKWARD_COMPATIBILITY=y

# Long Filename Support
CONFIG_FATFS_LFN_HEAP=y
CONFIG_FATFS_MAX_LFN=255
CONFIG_ESP_MAIN_TASK_STACK_SIZE=8192
```
